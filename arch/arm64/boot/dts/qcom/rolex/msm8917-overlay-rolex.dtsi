#include "msm8917-audio-rolex.dtsi"
#include "msm8917-camera-pinctrl-rolex.dtsi"
#include "msm8917-pinctrl-rolex.dtsi"
#include "msm8917-camera-sensor-qrd-rolex.dtsi"
#include "msm8917-mdss-rolex.dtsi"
#include "msm8917-pm-rolex.dtsi"
#include "msm8917-qrd-rolex.dtsi"
#include "msm8917-rolex.dtsi"
#include "msm8917-sku5-rolex.dtsi"
#include "msm8917-spmi-rolex.dtsi"
